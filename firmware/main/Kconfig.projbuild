## firmware/main/Kconfig.projbuild
```kconfig
menu "ARCANA hardware"
config ARCANA_WIFI_SSID
 string "Wi-Fi SSID (empty disables multiplayer networking)"
 default ""
config ARCANA_WIFI_PASSWORD
 string "Wi-Fi password"
 default ""
config ARCANA_ROTATE_180
 bool "Rotate display and touch by 180 degrees"
 default n
endmenu
```

## firmware/sdkconfig.defaults
```kconfig
CONFIG_IDF_TARGET="esp32s3"
CONFIG_ESPTOOLPY_FLASHSIZE_16MB=y
CONFIG_ESPTOOLPY_FLASHMODE_QIO=y
CONFIG_ESPTOOLPY_FLASHFREQ_80M=y
CONFIG_SPIRAM=y
CONFIG_SPIRAM_MODE_OCT=y
CONFIG_SPIRAM_SPEED_80M=y
CONFIG_SPIRAM_USE_MALLOC=y
CONFIG_SPIRAM_MALLOC_ALWAYSINTERNAL=16384
CONFIG_SPIRAM_MALLOC_RESERVE_INTERNAL=65536
CONFIG_ESP_DEFAULT_CPU_FREQ_MHZ_240=y
CONFIG_FREERTOS_HZ=1000
CONFIG_ESP_MAIN_TASK_STACK_SIZE=32768
CONFIG_COMPILER_CXX_EXCEPTIONS=y
CONFIG_COMPILER_CXX_RTTI=y
CONFIG_PARTITION_TABLE_CUSTOM=y
CONFIG_PARTITION_TABLE_CUSTOM_FILENAME="partitions.csv"
CONFIG_ESP_CONSOLE_USB_SERIAL_JTAG=y
CONFIG_ESP_LCD_TOUCH_CST816S_DISABLE_READ_ID=y
CONFIG_LWIP_SO_REUSE=y
CONFIG_LWIP_IGMP=y
CONFIG_COMPILER_OPTIMIZATION_SIZE=y
CONFIG_PM_ENABLE=y
CONFIG_FREERTOS_USE_TICKLESS_IDLE=y
CONFIG_PM_LIGHT_SLEEP_CALLBACKS=y
CONFIG_USJ_NO_AUTO_LS_ON_CONNECTION=y


CONFIG_BOOTLOADER_APP_ROLLBACK_ENABLE=y

CONFIG_MBEDTLS_CERTIFICATE_BUNDLE=y

# Experimental multiplayer BLE; all resources are released in Single/OTA mode.
CONFIG_BT_ENABLED=y
CONFIG_BT_NIMBLE_ENABLED=y
CONFIG_BT_NIMBLE_MAX_CONNECTIONS=9
CONFIG_BT_NIMBLE_MAX_CCCDS=9
CONFIG_BT_CTRL_BLE_MAX_ACT=10
CONFIG_BT_NIMBLE_ATT_PREFERRED_MTU=247
CONFIG_BT_NIMBLE_HOST_TASK_STACK_SIZE=8192
CONFIG_BT_NIMBLE_MSYS_1_BLOCK_COUNT=32
CONFIG_BT_NIMBLE_MSYS_2_BLOCK_COUNT=32
CONFIG_BT_NIMBLE_GATT_MAX_PROCS=12
CONFIG_BT_NIMBLE_LOG_LEVEL_WARNING=y
CONFIG_BT_CTRL_MODEM_SLEEP=y
CONFIG_BT_CTRL_LPCLK_SEL_MAIN_XTAL=y
CONFIG_BT_CTRL_MAIN_XTAL_PU_DURING_LIGHT_SLEEP=y
```
